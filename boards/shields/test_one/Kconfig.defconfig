## boards/shields/thumbkillerkeyboard3/Kconfig.defconfig
```kconfig
if SHIELD_THUMBKILLERKEYBOARD3

config ZMK_KEYBOARD_NAME
    default "ThumbKillerLeft"

endif
```

## boards/shields/thumbkillerkeyboard3/Kconfig.shield
```kconfig
config SHIELD_THUMBKILLERKEYBOARD3
    def_bool $(shields_list_contains,thumbkillerkeyboard3)
```
